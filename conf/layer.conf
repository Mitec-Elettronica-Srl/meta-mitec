## conf/layer.conf
```bitbake
BBPATH .= ":${LAYERDIR}"

# We have recipes-* directories, add to BBFILES
BBFILES += "${LAYERDIR}/recipes-*/*/*.bb \
            ${LAYERDIR}/recipes-*/*/*.bbappend"

BBFILE_COLLECTIONS += "mitec"
BBFILE_PATTERN_mitec = "^${LAYERDIR}/"
BBFILE_PRIORITY_mitec = "6"
LAYERVERSION_mitec = "5"
LAYERSERIES_COMPAT_mitec = "scarthgap"
```
